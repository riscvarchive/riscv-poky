## meta-riscv/conf/bblayers.conf.sample
```bitbake
# LAYER_CONF_VERSION is increased each time build/conf/bblayers.conf
# changes incompatibly
LCONF_VERSION = "6"

BBPATH = "${TOPDIR}"
BBFILES ?= ""

BBLAYERS ?= " \
  ${TOPDIR}/../meta \
  ${TOPDIR}/../meta-yocto \
  ${TOPDIR}/../meta-yocto-bsp \
  ${TOPDIR}/../meta-riscv \
  "
BBLAYERS_NON_REMOVABLE ?= " \
  ${TOPDIR}/../meta \
  ${TOPDIR}/../meta-yocto \
  "
```

## meta-riscv/conf/distro/include/tclibc-external-riscv-toolchain.inc
```bitbake
#
# External RISC-V glibc specific configuration
#
# Based on git://riscv-project.org/git/meta-riscv.git
# meta-riscv/meta-riscv-extras/conf/distro/include/tclibc-external-riscv.inc
#

LIBCEXTENSION = "${@['', '-gnu'][(d.getVar('ABIEXTENSION', True) or '') != '']}"

# Add glibc overrides to the overrides for eglibc.
LIBCOVERRIDE = ":libc-glibc"
OVERRIDES .= "${LIBCOVERRIDE}"

PREFERRED_PROVIDER_virtual/libiconv ?= "external-riscv-toolchain"
PREFERRED_PROVIDER_virtual/libintl ?= "external-riscv-toolchain"
PREFERRED_PROVIDER_virtual/libc ?= "external-riscv-toolchain"
PREFERRED_PROVIDER_virtual/libc-locale ?= "external-riscv-toolchain"

PREFERRED_PROVIDER_virtual/nativesdk-libiconv ?= "nativesdk-eglibc"
PREFERRED_PROVIDER_virtual/nativesdk-libintl ?= "nativesdk-eglibc"
PREFERRED_PROVIDER_virtual/nativesdk-libc ?= "nativesdk-eglibc"

LIBC_DEPENDENCIES = "libsegfault \
		     glibc \
		     glibc-dbg \
		     glibc-dev \
		     glibc-utils \
		     glibc-thread-db \
		     ${@get_libc_locales_dependencies(d)}"

LIBC_LOCALE_DEPENDENCIES = "\
	glibc-localedata-i18n \
	glibc-gconv-ibm850 \
	glibc-gconv-cp1252 \
	glibc-gconv-iso8859-1 \
	glibc-gconv-iso8859-15 \
	locale-base-en-us \
	locale-base-en-gb"

def get_libc_locales_dependencies(d):
    if 'libc-locales' in (d.getVar('DISTRO_FEATURES', True) or '').split() :
        return d.getVar('LIBC_LOCALE_DEPENDENCIES', True) or ''
    else:
        return ''
```

## meta-riscv/conf/distro/include/tcmode-external-riscv-linux.inc
```bitbake
#
# Configuration to use an external RISC-V binary toolchain
#
# Based on git://arago-project.org/git/meta-arago.git
# meta-arago/meta-arago-extras/conf/distro/include/tcmode-external-arago.inc
#

EXTERNAL_TOOLCHAIN ?= "${RISCV}"

ARAGO_TARGET_SYS = "riscv-linux"
TARGET_PREFIX = "riscv-linux-"

# Need to use newer linux headers, as 2011.09 has too old ones for newer udev
# PREFERRED_PROVIDER_linux-libc-headers = "linux-libc-headers"
# PREFERRED_PROVIDER_linux-libc-headers-dev = "linux-libc-headers"
# PREFERRED_PROVIDER_virtual/linux-libc-headers = "linux-libc-headers"

# A bit of a hack, but assume these are provided externally
PREFERRED_PROVIDER_linux-libc-headers = "external-riscv-toolchain"
PREFERRED_PROVIDER_linux-libc-headers-dev = "external-riscv-toolchain"
PREFERRED_PROVIDER_virtual/linux-libc-headers = "external-riscv-toolchain"

PREFERRED_PROVIDER_virtual/${TARGET_PREFIX}gcc = "external-riscv-toolchain"
PREFERRED_PROVIDER_virtual/${TARGET_PREFIX}gcc-initial = "external-riscv-toolchain"
PREFERRED_PROVIDER_virtual/${TARGET_PREFIX}gcc-intermediate = "external-riscv-toolchain"
PREFERRED_PROVIDER_virtual/${TARGET_PREFIX}g++ = "external-riscv-toolchain"
PREFERRED_PROVIDER_virtual/${TARGET_PREFIX}binutils = "external-riscv-toolchain"
PREFERRED_PROVIDER_virtual/${TARGET_PREFIX}libc-for-gcc = "external-riscv-toolchain"
PREFERRED_PROVIDER_virtual/${TARGET_PREFIX}compilerlibs = "external-riscv-toolchain"
PREFERRED_PROVIDER_libgcc = "external-riscv-toolchain"
PREFERRED_PROVIDER_virtual/libc = "external-riscv-toolchain"
PREFERRED_PROVIDER_virtual/libintl = "external-riscv-toolchain"
PREFERRED_PROVIDER_virtual/libiconv = "external-riscv-toolchain"
PREFERRED_PROVIDER_glibc-thread-db = "external-riscv-toolchain"
PREFERRED_PROVIDER_gdbserver = "external-riscv-toolchain"

PREFERRED_PROVIDER_gcc-cross-canadian-${TRANSLATED_TARGET_ARCH} ?= "external-riscv-sdk-toolchain"
PREFERRED_PROVIDER_binutils-cross-canadian-${TRANSLATED_TARGET_ARCH} ?= "external-riscv-sdk-toolchain"
#PREFERRED_PROVIDER_gdb-cross-canadian-${TRANSLATED_TARGET_ARCH} = "external-riscv-sdk-toolchain"

# Special case for gdb to be built as part of canadian-cross-sdk, instead of packaged from external toolchain
bindir_pn-gdb-cross-canadian-${TRANSLATED_TARGET_ARCH} = "${exec_prefix}/bin"
PREFERRED_PROVIDER_gdb-cross-canadian-${TRANSLATED_TARGET_ARCH} = "gdb-cross-canadian-${TRANSLATED_TARGET_ARCH}"

GCCVERSION ?= "4.5%"
SDKGCCVERSION ?= "4.5%"
BINUVERSION ?= "2.20%"
EGLIBCVERSION ?= "2.12%"
SDKLINUXLIBCVERSION ?= "3.10"

PREFERRED_VERSION_gcc ?= "${GCCVERSION}"
PREFERRED_VERSION_gcc-cross ?= "${GCCVERSION}"
PREFERRED_VERSION_gcc-cross-initial ?= "${GCCVERSION}"
PREFERRED_VERSION_gcc-cross-intermediate ?= "${GCCVERSION}"
PREFERRED_VERSION_gcc-crosssdk ?= "${SDKGCCVERSION}"
PREFERRED_VERSION_gcc-crosssdk-initial ?= "${SDKGCCVERSION}"
PREFERRED_VERSION_gcc-crosssdk-intermediate ?= "${SDKGCCVERSION}"
PREFERRED_VERSION_gcc-cross-canadian-${TRANSLATED_TARGET_ARCH} ?= "${GCCVERSION}"
PREFERRED_VERSION_gcc-runtime ?= "${GCCVERSION}"
PREFERRED_VERSION_nativesdk-gcc-runtime ?= "${SDKGCCVERSION}"
PREFERRED_VERSION_libgcc ?= "${GCCVERSION}"
PREFERRED_VERSION_nativesdk-libgcc ?= "${SDKGCCVERSION}"
PREFERRED_VERSION_binutils ?= "${BINUVERSION}"
PREFERRED_VERSION_binutils-cross ?= "${BINUVERSION}"
PREFERRED_VERSION_binutils-crosssdk ?= "${BINUVERSION}"
PREFERRED_VERSION_binutils-cross-canadian-${TRANSLATED_TARGET_ARCH} ?= "${BINUVERSION}"
PREFERRED_VERSION_nativesdk-linux-libc-headers ?= "${SDKLINUXLIBCVERSION}"
PREFERRED_VERSION_eglibc ?= "${EGLIBCVERSION}"
PREFERRED_VERSION_eglibc-locale ?= "${EGLIBCVERSION}"
PREFERRED_VERSION_nativesdk-eglibc ?= "${EGLIBCVERSION}"
PREFERRED_VERSION_eglibc-initial ?= "${EGLIBCVERSION}"
PREFERRED_VERSION_nativesdk-eglibc-initial ?= "${EGLIBCVERSION}"
PREFERRED_VERSION_cross-localedef-native ?= "${EGLIBCVERSION}"

TOOLCHAIN_OPTIONS = " --sysroot=${STAGING_DIR_HOST}"

DISTRO_FEATURES_LIBC = "ipv4 ipv6 libc-backtrace libc-big-macros libc-bsd libc-cxx-tests libc-catgets libc-crypt \
			libc-crypt-ufc libc-db-aliases libc-envz libc-fcvt libc-fmtmsg libc-fstab libc-ftraverse \
			libc-getlogin libc-idn libc-inet-anl libc-libm libc-libm-big \
			libc-memusage libc-nis libc-nsswitch libc-rcmd libc-rtld-debug libc-spawn libc-streams libc-sunrpc \
			libc-utmp libc-utmpx libc-wordexp libc-posix-clang-wchar libc-posix-regexp libc-posix-regexp-glibc \
			libc-posix-wchar-io"

ENABLE_BINARY_LOCALE_GENERATION = "0"
GLIBC_INTERNAL_USE_BINARY_LOCALE = "precompiled"
```

## meta-riscv/conf/distro/poky-riscv-tiny.conf
```bitbake
# Distribution definition for: poky-tiny
#
# Copyright (c) 2011, Intel Corporation.
# All rights reserved.
#
# This file is released under the MIT license as described in
# ../meta/COPYING.MIT.
#
# Poky-tiny is intended to define a tiny Linux system comprised of a
# Linux kernel tailored to support each specific MACHINE and busybox.
# Poky-tiny sets some basic policy to ensure a usable system while still
# keeping the rootfs and kernel image as small as possible.
#
# The policies defined are intended to meet the following goals:
# o Serial consoles only (no framebuffer or VGA console)
# o Basic support for IPV4 networking
# o Single user ash shell
# o Static images (no support for adding packages or libraries later)
# o Read-only or RAMFS root filesystem
# o Combined Linux kernel + rootfs in under 4MB
# o Allow the user to select between eglibc or uclibc with the TCLIBC variable
#
# This is currently a partial definition, the following tasks remain:
# [ ] Integrate linux-yocto-tiny ktype into linux-yocto
# [ ] Define linux-yocto-tiny configs for all supported BSPs
# [ ] Drop ldconfig from the installation
# [ ] Modify the runqemu scripts to work with ext2 parameter:
#     runqemu qemux86 qemuparams="-nographic" bootparams="console=ttyS0,115200 root=0800" 
# [ ] Modify busybox to allow for DISTRO_FEATURES-like confiruration

require conf/distro/poky.conf
DISTRO = "poky-riscv-tiny"

# FIXME: consider adding a new "tiny" feature
#DISTRO_FEATURES_append = " tiny"

# Distro config is evaluated after the machine config, so we have to explicitly
# set the kernel provider to override a machine config.
PREFERRED_PROVIDER_virtual/kernel = "linux-riscv"
PREFERRED_VERSION_linux-riscv = "4.1%"

# We can use packagegroup-core-boot, but in the future we may need a new packagegroup-core-tiny
#POKY_DEFAULT_EXTRA_RDEPENDS += "packagegroup-core-boot"
# Drop kernel-module-af-packet from RRECOMMENDS
POKY_DEFAULT_EXTRA_RRECOMMENDS = ""

# FIXME: what should we do with this?
TCLIBCAPPEND = ""

# Disable wide char support for ncurses as we don't include it in
# in the LIBC features below.
ENABLE_WIDEC="false"

# Drop native language support. This removes the
# eglibc->bash->gettext->libc-posix-clang-wchar dependency.
USE_NLS="no"

# Reconfigure eglibc for a smaller installation
# Comment out any of the lines below to disable them in the build
DISTRO_FEATURES_LIBC_TINY = "libc-libm libc-crypt"
#DISTRO_FEATURES_LIBC_TINY_append_x86-64 = " libc-libm-big"

# Required for "who"
DISTRO_FEATURES_LIBC_MINIMAL = "libc-utmp libc-getlogin"
DISTRO_FEATURES_LIBC_REGEX = "libc-posix-regexp"
DISTRO_FEATURES_LIBC_NET = "libc-inet libc-nis"

DISTRO_FEATURES_LIBC = "${DISTRO_FEATURES_LIBC_TINY} \
                        ${DISTRO_FEATURES_LIBC_MINIMAL} \
                        ${DISTRO_FEATURES_LIBC_REGEX} \
                        ${DISTRO_FEATURES_LIBC_NET} \
                       "

# Comment out any of the lines below to disable them in the build
# DISTRO_FEATURES options:
# alsa bluetooth ext2 irda pcmcia usbgadget usbhost wifi nfs zeroconf pci
#DISTRO_FEATURES_TINY = "pci"
#DISTRO_FEATURES_NET = "ipv4"
#DISTRO_FEATURES_USB = "usbhost"
#DISTRO_FEATURES_USBGADGET = "usbgadget"
#DISTRO_FEATURES_WIFI = "wifi"

DISTRO_FEATURES = "${DISTRO_FEATURES_TINY} \
                   ${DISTRO_FEATURES_NET} \
                   ${DISTRO_FEATURES_USB} \
                   ${DISTRO_FEATURES_USBGADGET} \
                   ${DISTRO_FEATURES_WIFI} \
                   ${DISTRO_FEATURES_LIBC} \
                  "

# Enable LFS - see bug YOCTO #5865
#DISTRO_FEATURES_append_libc-uclibc = " largefile"

# Use tmpdevfs and the busybox runtime services
VIRTUAL-RUNTIME_dev_manager = ""
VIRTUAL-RUNTIME_login_manager = ""
VIRTUAL-RUNTIME_init_manager = "riscv-init"
VIRTUAL-RUNTIME_keymaps = ""

# FIXME: Consider adding "modules" to MACHINE_FEATURES and using that in
# packagegroup-core-base to select modutils-initscripts or not.  Similar with "net" and
# netbase.

# By default we only support ext2 and initramfs. We don't build live as that
# pulls in a lot of dependencies for the live image and the installer, like
# udev, grub, etc.  These pull in gettext, which fails to build with wide
# character support.
IMAGE_FSTYPES = "ext2 cpio.gz"

# Drop v86d from qemu dependency list (we support serial)
# Drop grub from meta-intel BSPs
# FIXME: A different mechanism is needed here. We could define -tiny
#        variants of all compatible machines, but that leads to a lot
#        more machine configs to maintain long term.
MACHINE_ESSENTIAL_EXTRA_RDEPENDS = ""

# The mtrace script included by eglibc is a perl script. This means the system
# will build perl in case this package is installed. Since we don't care about
# this script for the purposes of tiny, remove the dependency from here.
RDEPENDS_${PN}-mtrace_pn-eglibc = ""

INHERIT += "blacklist"
PNBLACKLIST[build-appliance-image] = "not buildable with poky-riscv"
PNBLACKLIST[core-image-base] = "not buildable with poky-riscv"
PNBLACKLIST[core-image-clutter] = "not buildable with poky-riscv"
PNBLACKLIST[core-image-directfb] = "not buildable with poky-riscv"
PNBLACKLIST[core-image-full-cmdline] = "not buildable with poky-riscv"
PNBLACKLIST[core-image-lsb] = "not buildable with poky-riscv"
PNBLACKLIST[core-image-lsb-dev] = "not buildable with poky-riscv"
PNBLACKLIST[core-image-lsb-sdk] = "not buildable with poky-riscv"
PNBLACKLIST[core-image-rt] = "not buildable with poky-riscv"
PNBLACKLIST[core-image-rt-sdk] = "not buildable with poky-riscv"
PNBLACKLIST[core-image-sato] = "not buildable with poky-riscv"
PNBLACKLIST[core-image-sato-dev] = "not buildable with poky-riscv"
PNBLACKLIST[core-image-sato-sdk] = "not buildable with poky-riscv"
PNBLACKLIST[core-image-x11] = "not buildable with poky-riscv"
PNBLACKLIST[qt4e-demo-image] = "not buildable with poky-riscv"
PNBLACKLIST[core-image-weston] = "not buildable with poky-riscv"

# Exclude packages not ported for riscv yet
PNBLACKLIST[eglibc] = "eglibc hasn't been ported for riscv yet"
PNBLACKLIST[libart-lgpl] = "need to generate art_config.h for riscv first"
PNBLACKLIST[ghostscript] = "need to generate objarch.h for riscv first"

# Disable python usage in opkg-utils since it won't build with tiny config
PACKAGECONFIG_pn-opkg-utils = ""

CORE_IMAGE_EXTRA_INSTALL += "glibc"

# Old GCC toolchain (riscv-tools)
#GCCVERSION = "4.6.1"
#SDKGCCVERSION = "${GCCVERSION}"
#BINUVERSION = "2.21%"
#GLIBCVERSION = "2.14%"

# New GCC toolchain
GCCVERSION = "4.9.1"
SDKGCCVERSION = "${GCCVERSION}"
BINUVERSION = "2.24"
GLIBCVERSION = "2.20"

# Set a couple of specific versions for the native utilities
PREFERRED_VERSION_binutils-native := "2.24"
PREFERRED_VERSION_gcc-native := "4.9%"

# Make sure Linux header versions and Linux version fit.
PREFERRED_VERSION_linux-libc-headers := "${PREFERRED_VERSION_linux-riscv}"
PREFERRED_VERSION_nativesdk-linux-libc-headers := "${PREFERRED_VERSION_linux-riscv}"
```

## meta-riscv/conf/distro/poky-riscv.conf
```bitbake
# Distro config is evaluated after the machine config, so we have to explicitly
# set the kernel provider to override a machine config.
PREFERRED_PROVIDER_virtual/kernel = "linux-riscv"
PREFERRED_VERSION_linux-riscv = "4.1%"

# New GCC toolchain
GCCVERSION = "5.3.0"
SDKGCCVERSION = "${GCCVERSION}"
BINUVERSION = "2.25.1"
GLIBCVERSION = "2.22"

# Set a couple of specific versions for the native utilities
PREFERRED_VERSION_binutils-native := "2.25.1"
PREFERRED_VERSION_gcc-native := "5.3"

PREFERRED_VERSION_python-riscv := "2.7.3"

PREFERRED_VERSION_libffi-riscv := "3.1"
PREFERRED_VERSION_libffi-native := "3.2.1"

# Make sure Linux header versions and Linux version fit.
PREFERRED_VERSION_linux-libc-headers := "${PREFERRED_VERSION_linux-riscv}"
PREFERRED_VERSION_nativesdk-linux-libc-headers := "${PREFERRED_VERSION_linux-riscv}"

# Exclude packages not ported for riscv yet
PNBLACKLIST[eglibc] = "eglibc hasn't been ported for riscv yet"
PNBLACKLIST[libart-lgpl] = "need to generate art_config.h for riscv first"
PNBLACKLIST[ghostscript] = "need to generate objarch.h for riscv first"

PNBLACKLIST[gdb-cross-canadian] = "gdb not ported to riscv yet"

IMAGE_FSTYPES = "ext2 cpio.gz"

VIRTUAL-RUNTIME_dev_manager = ""
VIRTUAL-RUNTIME_init_manager = "sysvinit"

require conf/distro/include/poky-floating-revisions.inc
require conf/distro/poky.conf

DISTRO = "poky-riscv"
DISTROOVERRIDES = "poky"

POKY_DEFAULT_DISTRO_FEATURES = "largefile ptest"
```
